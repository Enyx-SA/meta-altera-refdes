## conf/layer.conf
```bitbake
# We have a conf and classes directory, add to BBPATH
BBPATH .= ":${LAYERDIR}"

# We have recipes-* directories, add to BBFILES
BBFILES += "${LAYERDIR}/recipes-*/*/*.bb ${LAYERDIR}/recipes-*/*/*.bbappend"

BBFILE_COLLECTIONS += "meta-altera-refdes"
BBFILE_PATTERN_meta-altera-refdes = "^${LAYERDIR}/"
BBFILE_PRIORITY_meta-altera-refdes = "8"

# This should only be incremented on significant changes that will
# cause compatibility issues with other layers
LAYERVERSION_meta-altera-refdes = "1"

LAYERDEPENDS_meta-altera-refdes = "meta-altera"
```

## conf/machine/atlas_soc.conf
```bitbake
#@TYPE: Machine
#@NAME: atlas_soc
#@DESCRIPTION: Machine configuration for the Cyclone V Atlas SoC DevKit"

require conf/machine/include/socfpga.inc

PREFERRED_VERSION_u-boot-socfpga = "2013.01.01"

UBOOT_MACHINE = "socfpga_cyclone5"

KMACHINE = "atlas_soc"

KERNEL_DEVICETREE = "socfpga_cyclone5_atlas_socdk.dtb"
```

## conf/machine/atlas_socdk.conf
```bitbake
#@TYPE: Machine
#@NAME: atlas_soc
#@DESCRIPTION: Machine configuration for the Cyclone V Atlas SoC DevKit"

require conf/machine/include/socfpga.inc

KERNEL_PROVIDER="linux-altera"

PREFERRED_VERSION_u-boot-socfpga = "2013.01.01"

UBOOT_MACHINE = "socfpga_cyclone5"

KMACHINE = "atlas_socdk"

KERNEL_DEVICETREE = "socfpga_cyclone5_de0.dtb"
```

## conf/machine/socfpga-cyclone5-socdk.conf
```bitbake
#@TYPE: Machine
#@NAME: socfpga_cyclone5_socdk 
#@DESCRIPTION: Machine configuration for the Cyclone V Altera SoC DevKit"

require conf/machine/include/socfpga.inc

PREFERRED_VERSION_u-boot-socfpga = "2013.01.01"

UBOOT_MACHINE = "socfpga_cyclone5"

KMACHINE = "socfpga-cyclone5-socdk"

if [ "${KERNEL_PROVIDER}" == "linux-altera" ] ; then
  KERNEL_DEVICETREE = "socfpga_cyclone5_socdk.dtb"
else
  KERNEL_DEVICETREE = "socfpga_cyclone5.dtb"
fi
```

## conf/machine/socfpga_cyclone5_socdk.conf
```bitbake
#@TYPE: Machine
#@NAME: socfpga_cyclone5_socdk 
#@DESCRIPTION: Machine configuration for the Cyclone V Altera SoC DevKit"

require conf/machine/include/socfpga.inc

PREFERRED_VERSION_u-boot-socfpga = "2013.01.01"

UBOOT_MACHINE = "socfpga_cyclone5"

KMACHINE = "socfpga_cyclone5_socdk"

KERNEL_DEVICETREE = "socfpga_cyclone5_socdk.dtb"
```
